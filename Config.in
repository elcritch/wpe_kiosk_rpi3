## Config.in
```kconfig
# Include all package configuration snippets from the overlay.
source "$NERVES_DEFCONFIG_DIR/package/cog-rdk/Config.in"
source "$NERVES_DEFCONFIG_DIR/package/eglinfo/Config.in"
source "$NERVES_DEFCONFIG_DIR/package/libwpe-rdk/Config.in"
source "$NERVES_DEFCONFIG_DIR/package/wpebackend-rdk/Config.in"
source "$NERVES_DEFCONFIG_DIR/package/wpewebkit-rdk/Config.in"
```

## nerves_defconfig
```kconfig
BR2_arm=y
BR2_cortex_a53=y
BR2_ARM_FPU_NEON_VFPV4=y
BR2_TAR_OPTIONS="--no-same-owner"
BR2_OPTIMIZE_2=y

BR2_GLOBAL_PATCH_DIR="${BR2_EXTERNAL_NERVES_PATH}/patches"
BR2_TOOLCHAIN_EXTERNAL=y
BR2_TOOLCHAIN_EXTERNAL_CUSTOM=y
BR2_TOOLCHAIN_EXTERNAL_DOWNLOAD=y
BR2_TOOLCHAIN_EXTERNAL_URL="https://github.com/nerves-project/toolchains/releases/download/v1.2.0/nerves_toolchain_arm_unknown_linux_gnueabihf-linux_x86_64-1.2.0-EDC6266.tar.xz"
BR2_TOOLCHAIN_EXTERNAL_CUSTOM_PREFIX="arm-unknown-linux-gnueabihf"
BR2_TOOLCHAIN_EXTERNAL_GCC_8=y
BR2_TOOLCHAIN_EXTERNAL_HEADERS_4_4=y
BR2_TOOLCHAIN_EXTERNAL_CUSTOM_GLIBC=y
BR2_TOOLCHAIN_EXTERNAL_CXX=y
BR2_TOOLCHAIN_EXTERNAL_HAS_THREADS=y
BR2_ROOTFS_SKELETON_CUSTOM=y
BR2_ROOTFS_SKELETON_CUSTOM_PATH="${BR2_EXTERNAL_NERVES_PATH}/board/nerves-common/skeleton"

BR2_INIT_NONE=y
BR2_ENABLE_LOCALE_WHITELIST="locale-archive"
BR2_GENERATE_LOCALE="en_US.UTF-8"
BR2_ROOTFS_OVERLAY="${BR2_EXTERNAL_NERVES_PATH}/board/nerves-common/rootfs_overlay ${NERVES_DEFCONFIG_DIR}/rootfs_overlay"
BR2_ROOTFS_POST_BUILD_SCRIPT="${NERVES_DEFCONFIG_DIR}/post-build.sh ${BR2_EXTERNAL_NERVES_PATH}/board/nerves-common/post-build.sh"
BR2_ROOTFS_POST_IMAGE_SCRIPT="${NERVES_DEFCONFIG_DIR}/post-createfs.sh"
BR2_LINUX_KERNEL=y
BR2_LINUX_KERNEL_CUSTOM_TARBALL=y
BR2_LINUX_KERNEL_CUSTOM_TARBALL_LOCATION="$(call github,raspberrypi,linux,e20d30ad915620f2575c8e8f77095f7d42bd9ab1)/linux-e20d30ad915620f2575c8e8f77095f7d42bd9ab1.tar.gz"
BR2_LINUX_KERNEL_USE_CUSTOM_CONFIG=y
BR2_LINUX_KERNEL_CUSTOM_CONFIG_FILE="${NERVES_DEFCONFIG_DIR}/linux-4.19.defconfig"
BR2_LINUX_KERNEL_XZ=y
BR2_LINUX_KERNEL_DTS_SUPPORT=y
BR2_LINUX_KERNEL_INTREE_DTS_NAME="bcm2710-rpi-3-b bcm2710-rpi-cm3 bcm2710-rpi-3-b-plus"
BR2_LINUX_KERNEL_CUSTOM_DTS_PATH="${NERVES_DEFCONFIG_DIR}/ramoops.dts"
# BR2_LINUX_KERNEL_PATCH="${NERVES_DEFCONFIG_DIR}/patches/linux/"
BR2_PACKAGE_BUSYBOX_CONFIG="${BR2_EXTERNAL_NERVES_PATH}/board/nerves-common/busybox-1.22.config"
BR2_PACKAGE_ALSA_UTILS=y
BR2_PACKAGE_BTRFS_PROGS=y

## Start WPE Deps ##
BR2_PACKAGE_BITSTREAM_VERA=y
BR2_ROOTFS_DEVICE_CREATION_DYNAMIC_EUDEV=y
BR2_PACKAGE_EUDEV=y
## End WPE Deps ##


# BR2_PACKAGE_ALSA_UTILS_ALSAMIXER is not set
BR2_PACKAGE_ALSA_UTILS_AMIXER=y
BR2_PACKAGE_ALSA_UTILS_APLAY=y
BR2_PACKAGE_ESPEAK=y
BR2_PACKAGE_E2FSPROGS=y
# BR2_PACKAGE_E2FSPROGS_FSCK is not set
BR2_PACKAGE_RPI_FIRMWARE=y
BR2_PACKAGE_RPI_FIRMWARE_KERNEL_4_14=y
BR2_PACKAGE_RPI_FIRMWARE_X=y
BR2_PACKAGE_RPI_WIFI_FIRMWARE=y
BR2_PACKAGE_PIGPIO=y

## Graphics ##

## Start WPE Packages ##
#BR2_PACKAGE_RPI_USERLAND=y
#BR2_PACKAGE_RPI_USERLAND_START_VCFILED=y
BR2_PACKAGE_RPI_FIRMWARE=y
BR2_PACKAGE_DROPBEAR=y

BR2_PACKAGE_PROVIDES_LIBEGL="rpi-userland"
BR2_PACKAGE_PROVIDES_LIBGLES="rpi-userland"
BR2_PACKAGE_GST1_PLUGINS_BASE_LIB_OPENGL_EGL=y
BR2_PACKAGE_GST1_PLUGINS_BASE_LIB_OPENGL=y
BR2_PACKAGE_GST1_PLUGINS_BASE_HAS_LIB_OPENGL=y
BR2_PACKAGE_GST1_PLUGINS_BASE_LIB_OPENGL_HAS_API=y
BR2_PACKAGE_GST1_PLUGINS_BASE_LIB_OPENGL_GLES2=y
BR2_PACKAGE_GST1_PLUGINS_BASE_LIB_OPENGL_HAS_PLATFORM=y
BR2_PACKAGE_GST1_PLUGINS_BASE_LIB_OPENGL_EGL=y
BR2_PACKAGE_GST1_PLUGINS_BASE_LIB_OPENGL_HAS_WINDOW=y
BR2_PACKAGE_GST1_PLUGINS_BASE_LIB_OPENGL_DISPMANX=y
# BR2_PACKAGE_HAS_LIBEGL_WAYLAND=y
# BR2_PACKAGE_MESA3D=y
# BR2_PACKAGE_MESA3D_DRIVER=y
# BR2_PACKAGE_MESA3D_OPENGL_EGL=y
# BR2_PACKAGE_MESA3D_GALLIUM_DRIVER_VC4=y
# BR2_PACKAGE_MESA3D_OPENGL_ES=y
#
# BR2_PACKAGE_CAIRO=y
# BR2_PACKAGE_CAIRO_PNG=y
# BR2_PACKAGE_HARFBUZZ=y
# BR2_PACKAGE_ICU=y
# BR2_PACKAGE_JPEG=y
# BR2_PACKAGE_LIBEPOXY=y
# BR2_PACKAGE_LIBGCRYPT=y
# BR2_PACKAGE_LIBPNG=y
# BR2_PACKAGE_LIBSOUP=y
# BR2_PACKAGE_LIBWPE_RDK=y
# BR2_PACKAGE_LIBXML2=y
# BR2_PACKAGE_SQLITE=y
# BR2_PACKAGE_WEBP=y
# BR2_PACKAGE_WEBP_DEMUX=y
# BR2_PACKAGE_WOFF2=y

BR2_PACKAGE_LIBWPE_RDK=y
BR2_PACKAGE_WPEWEBKIT_RDK=y
#BR2_EXTERNAL_WPE_PATH="${NERVES_DEFCONFIG_DIR}/"
BR2_PACKAGE_COG_RDK=y
BR2_PACKAGE_COG_RDK_PROGRAMS=y
BR2_PACKAGE_COG_RDK_PROGRAMS_DBUS_SYSTEM_BUS=y
BR2_PACKAGE_COG_RDK_PROGRAMS_HOME_URI="https://wpewebkit.org"
BR2_PACKAGE_EGLINFO=y
BR2_PACKAGE_WPEBACKEND_RDK=y
BR2_PACKAGE_WPEWEBKIT_RDK=y
BR2_PACKAGE_WPEWEBKIT_RDK_BUILD_JSC=y
# BR2_PACKAGE_WPEWEBKIT_MINIBROWSER=y
BR2_PACKAGE_WPEWEBKIT_RDK_MULTIMEDIA=y
BR2_PACKAGE_GST_OMX=y
BR2_PACKAGE_UTIL_LINUX_LIBMOUNT=y

## End WPE Packages ##

# BR2_EXTERNAL="${BR2_EXTERNAL_NERVES_PATH}/ ${BR2_EXTERNAL_WPE_PATH}"

BR2_PACKAGE_LIBMNL=y
BR2_PACKAGE_LIBGLIB2=y
BR2_PACKAGE_WIRELESS_REGDB=y
BR2_PACKAGE_WPA_SUPPLICANT=y
BR2_PACKAGE_WPA_SUPPLICANT_AP_SUPPORT=y
BR2_PACKAGE_WPA_SUPPLICANT_EAP=y
BR2_PACKAGE_WPA_SUPPLICANT_HOTSPOT=y
BR2_PACKAGE_WPA_SUPPLICANT_DEBUG_SYSLOG=y
BR2_PACKAGE_WPA_SUPPLICANT_PASSPHRASE=y
# BR2_TARGET_ROOTFS_TAR is not set
BR2_NERVES_SYSTEM_NAME="nerves_system_rpi3"
BR2_NERVES_ADDITIONAL_IMAGE_FILES="${NERVES_DEFCONFIG_DIR}/fwup.conf ${NERVES_DEFCONFIG_DIR}/cmdline.txt ${NERVES_DEFCONFIG_DIR}/config.txt"
BR2_PACKAGE_LIBP11=y
BR2_PACKAGE_NBTTY=y
BR2_PACKAGE_NERVES_CONFIG=y

BR2_PACKAGE_BCACHE_TOOLS=y
```

## package/cog-rdk/Config.in
```kconfig
config BR2_PACKAGE_COG_RDK
	bool "cog"
	depends on BR2_PACKAGE_WPEWEBKIT_RDK
	help
	  Single “window” launcher for the WebKit WPE port, and
	  helper library for implementing WPE launcher. It does
	  not provide any chrome, and is suitable to be used
	  as a Web application container.

if BR2_PACKAGE_COG_RDK

config BR2_PACKAGE_COG_RDK_PROGRAMS
	bool "build and install programs"
	help
	  Build and install the "cog" and "cogctl" programs.

if BR2_PACKAGE_COG_RDK_PROGRAMS

config BR2_PACKAGE_COG_RDK_PROGRAMS_DBUS_SYSTEM_BUS
	bool "expose remote control interface on system bus"
	help
	  If enabled, the D-Bus remote control interface is exposed
	  on the system bus, instead of the session bus.

config BR2_PACKAGE_COG_RDK_PROGRAMS_HOME_URI
	string "home uri"
	default ""
	help
	  Default URI to open when "cog" is launched. If an empty
	  string is used, there is no default and the URI to open
	  must be always specified in the command line.

endif

endif
```
